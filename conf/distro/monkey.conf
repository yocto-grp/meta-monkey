## conf/distro/monkey.conf
```bitbake
require conf/distro/poky.conf
DISTRO = "monkey"
DISTRO_NAME = "Monkey Linux"
DISTRO_VERSION = "0.1"
SDK_VENDOR = "-monkeysdk"
SDK_VERSION := "${@'${DISTRO_VERSION}'.replace('snapshot-${DATE}','snapshot')}"
MAINTAINER = "hominlinx <monkeyyuan635@gmail.com>"

TARGET_VENDOR = "-monkey"

INHERIT += "rm_work"

DISTRO_FEATURES += "alsa"
DISTRO_FEATURES_remove = "nfs zeroconf directfb x11 wayland 3g bluetooth irda nfc pci wifi usbgadget pcmcia pulseaudio"
```

## meta-bananapi/conf/machine/bpi.conf
```bitbake
#@TYPE: Machine
#@NAME: Bananapi
#@DESCRIPTION: Machine configuration for the bananapi, based on allwinner A20 CPU http://bananapi.org/

require conf/machine/include/sun7i.inc


PREFERRED_PROVIDER_u-boot = "u-boot-monkey-bpi"
PREFERRED_PROVIDER_virtual/bootloader = "u-boot-monkey-bpi"
PREFERRED_PROVIDER_virtual/kernel = "linux-monkey-bpi"

KERNEL_DEVICETREE = "sun7i-a20-bananapi.dtb"
UBOOT_MACHINE = "Bananapi_config"
#SUNXI_FEX_FILE = "sys_config/a20/BananaPii.fex"
SUNXI_FEX_FILE = "Bananapii.fex"

UBOOT_MAKE_TARGET = "all"
```
